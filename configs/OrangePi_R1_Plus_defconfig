## configs/OrangePi_R1_Plus_defconfig
```kconfig
CONFIG_TARGET_rockchip=y
CONFIG_TARGET_rockchip_armv8=y
CONFIG_TARGET_rockchip_armv8_DEVICE_xunlong_orangepi-r1-plus=y
CONFIG_TARGET_ROOTFS_PARTSIZE=600

# CONFIG_PACKAGE_dnsmasq is not set
CONFIG_PACKAGE_dnsmasq-full=y
CONFIG_PACKAGE_iperf3=y
CONFIG_PACKAGE_docker=y
CONFIG_PACKAGE_dockerd=y
CONFIG_PACKAGE_rsync=y
CONFIG_PACKAGE_rsyncd=y
CONFIG_PACKAGE_openssh-sftp-server=y
CONFIG_PACKAGE_iptables-mod-conntrack-extra=y
CONFIG_PACKAGE_iptables-mod-ipopt=y
CONFIG_PACKAGE_iptables-mod-tproxy=y
CONFIG_PACKAGE_zerotier=y
CONFIG_PACKAGE_wpa-supplicant=y
CONFIG_PACKAGE_uhttpd=y
CONFIG_PACKAGE_uhttpd-mod-ubus=y
CONFIG_PACKAGE_hostapd=y
CONFIG_PACKAGE_hostapd-common=y
CONFIG_PACKAGE_ifstat=y
CONFIG_PACKAGE_iftop=y
CONFIG_PACKAGE_ipset=y
CONFIG_PACKAGE_netperf=y
CONFIG_PACKAGE_squid=y
CONFIG_PACKAGE_tcpdump=y
CONFIG_PACKAGE_speedtest-netperf=y
CONFIG_PACKAGE_htop=y
CONFIG_PACKAGE_libusb-1.0=y
CONFIG_PACKAGE_blkid=y

CONFIG_LUCI_LANG_zh_Hans=y
CONFIG_PACKAGE_luci-app-dockerman=y
CONFIG_DOCKER_OPTIONAL_FEATURES=y
CONFIG_PACKAGE_luci-app-ttyd=y
CONFIG_PACKAGE_luci-app-samba4=y
CONFIG_PACKAGE_luci-app-statistics=y
CONFIG_PACKAGE_luci-app-transmission=y
CONFIG_PACKAGE_luci-app-banip=y
CONFIG_PACKAGE_luci-app-commands=y
CONFIG_PACKAGE_luci-app-vnstat2=y
# CONFIG_PACKAGE_luci-theme-argon is not set
CONFIG_PACKAGE_luci-app-aria2=y
CONFIG_PACKAGE_luci-app-ddns=y
CONFIG_PACKAGE_luci-app-wireguard=y
CONFIG_PACKAGE_luci-app-watchcat=y
CONFIG_PACKAGE_luci-app-adblock=y
CONFIG_PACKAGE_luci-app-nlbwmon=y
CONFIG_PACKAGE_luci-app-ntpc=y
CONFIG_PACKAGE_luci-app-mwan3=y
CONFIG_PACKAGE_luci-app-qos=y
CONFIG_PACKAGE_luci-app-unbound=y

CONFIG_PACKAGE_collectd-mod-ping=y
CONFIG_PACKAGE_collectd-mod-thermal=y
CONFIG_PACKAGE_kmod-mt76x0u=y
CONFIG_PACKAGE_kmod-mt7601u=y
CONFIG_PACKAGE_kmod-mt76x2u=y
CONFIG_PACKAGE_kmod-rtl8821cu=y
CONFIG_PACKAGE_kmod-rtl8812au-ct=y
CONFIG_PACKAGE_kmod-rtl8821ae=y
CONFIG_PACKAGE_kmod-rtl8xxxu=y
CONFIG_PACKAGE_kmod-ipt-nat6=y
CONFIG_PACKAGE_kmod-nf-nat6=y
CONFIG_PACKAGE_kmod-usb-serial-option=y
CONFIG_PACKAGE_mt7601u-firmware=y
CONFIG_PACKAGE_rtl8188eu-firmware=y
CONFIG_PACKAGE_rtl8723au-firmware=y
CONFIG_PACKAGE_rtl8723bu-firmware=y
CONFIG_PACKAGE_rtl8821ae-firmware=y
CONFIG_PACKAGE_iw=y
CONFIG_PACKAGE_iwinfo=y
CONFIG_PACKAGE_wpad-wolfssl=y
CONFIG_DRIVER_11AC_SUPPORT=y
CONFIG_DRIVER_11N_SUPPORT=y
```

## configs/orangepi-3b-rk3566_defconfig
```kconfig
CONFIG_TARGET_rockchip=y
CONFIG_TARGET_rockchip_armv8=y
CONFIG_TARGET_rockchip_armv8_DEVICE_xunlong_orangepi-3b=y
CONFIG_TARGET_KERNEL_PARTSIZE=64
CONFIG_TARGET_ROOTFS_PARTSIZE=400
# CONFIG_PACKAGE_dnsmasq is not set
CONFIG_PACKAGE_dnsmasq-full=y
CONFIG_PACKAGE_iperf3=y
CONFIG_PACKAGE_docker=y
CONFIG_PACKAGE_dockerd=y
CONFIG_PACKAGE_rsync=y
CONFIG_PACKAGE_rsyncd=y
CONFIG_PACKAGE_openssh-sftp-server=y
CONFIG_PACKAGE_iptables-mod-conntrack-extra=y
CONFIG_PACKAGE_iptables-mod-ipopt=y
CONFIG_PACKAGE_iptables-mod-tproxy=y
CONFIG_PACKAGE_zerotier=y
CONFIG_PACKAGE_wpa-supplicant=y
CONFIG_PACKAGE_uhttpd=y
CONFIG_PACKAGE_uhttpd-mod-ubus=y
CONFIG_PACKAGE_hostapd=y
CONFIG_PACKAGE_ifstat=y
CONFIG_PACKAGE_iftop=y
CONFIG_PACKAGE_ipset=y
CONFIG_PACKAGE_netperf=y
CONFIG_PACKAGE_squid=y
CONFIG_PACKAGE_tcpdump=y
CONFIG_PACKAGE_speedtest-netperf=y
CONFIG_PACKAGE_htop=y
CONFIG_PACKAGE_libusb-1.0=y
CONFIG_PACKAGE_blkid=y
CONFIG_PACKAGE_collectd-mod-ping=y
CONFIG_PACKAGE_collectd-mod-thermal=y
CONFIG_PACKAGE_iw=y
CONFIG_PACKAGE_iwinfo=y
CONFIG_PACKAGE_wpad-wolfssl=y
CONFIG_PACKAGE_usbutils=y
CONFIG_PACKAGE_usb-modeswitch=y

CONFIG_LUCI_LANG_zh_Hans=y
CONFIG_PACKAGE_luci-app-dockerman=y
CONFIG_PACKAGE_luci-app-ttyd=y
CONFIG_PACKAGE_luci-app-samba4=y
CONFIG_PACKAGE_luci-app-statistics=y
CONFIG_PACKAGE_luci-app-transmission=y
CONFIG_PACKAGE_luci-app-commands=y
CONFIG_PACKAGE_luci-app-vnstat2=y
# CONFIG_PACKAGE_luci-theme-argon is not set
CONFIG_PACKAGE_luci-app-aria2=y
CONFIG_PACKAGE_luci-app-ddns=y
CONFIG_PACKAGE_luci-app-watchcat=y
CONFIG_PACKAGE_luci-app-adblock=y
CONFIG_PACKAGE_luci-app-nlbwmon=y
CONFIG_PACKAGE_luci-app-ntpc=y
CONFIG_PACKAGE_luci-app-mwan3=y
CONFIG_PACKAGE_luci-app-qos=y
CONFIG_PACKAGE_luci-app-unbound=y

CONFIG_PACKAGE_kmod-rtw88-8821cu=y
CONFIG_PACKAGE_kmod-rtl8xxxu=y
CONFIG_PACKAGE_kmod-mt76x0u=y
CONFIG_PACKAGE_kmod-mt7601u=y
CONFIG_PACKAGE_kmod-mt76x2u=y
CONFIG_PACKAGE_kmod-rtl8812au-ct=y
CONFIG_PACKAGE_kmod-rtl8821ae=y
CONFIG_PACKAGE_kmod-rtl8xxxu=y
CONFIG_PACKAGE_kmod-ipt-nat6=y
CONFIG_PACKAGE_kmod-nf-nat6=y
CONFIG_PACKAGE_kmod-usb-serial-option=y
CONFIG_TESTING_KERNEL=y
```

## configs/orangepi-5-pro-rk3588-spi_defconfig
```kconfig
CONFIG_TARGET_rockchip=y
CONFIG_TARGET_rockchip_armv8=y
CONFIG_TARGET_rockchip_armv8_DEVICE_xunlong_orangepi-5-pro-spi=y
# CONFIG_TARGET_ROOTFS_EXT4FS is not set

CONFIG_PACKAGE_openssh-sftp-server=y
CONFIG_PACKAGE_wpa-supplicant=y
CONFIG_PACKAGE_hostapd=y
CONFIG_PACKAGE_kmod-brcmfmac=y
CONFIG_PACKAGE_brcmfmac-firmware=y
CONFIG_PACKAGE_kmod-yt6801=y
```

## configs/orangepi-5-pro-rk3588_defconfig
```kconfig
CONFIG_TARGET_rockchip=y
CONFIG_TARGET_rockchip_armv8=y
CONFIG_TARGET_rockchip_armv8_DEVICE_xunlong_orangepi-5-pro=y
CONFIG_TARGET_ROOTFS_EXT4FS=y
CONFIG_TARGET_KERNEL_PARTSIZE=64
CONFIG_TARGET_ROOTFS_PARTSIZE=400

CONFIG_PACKAGE_openssh-sftp-server=y
CONFIG_PACKAGE_wpa-supplicant=y
CONFIG_PACKAGE_hostapd=y
CONFIG_PACKAGE_kmod-brcmfmac=y
CONFIG_PACKAGE_brcmfmac-firmware=y
CONFIG_PACKAGE_kmod-yt6801=y
```

## configs/orangepi-5-rk3588-spi_defconfig
```kconfig
CONFIG_TARGET_rockchip=y
CONFIG_TARGET_rockchip_armv8=y
CONFIG_TARGET_rockchip_armv8_DEVICE_xunlong_orangepi-5-spi=y
# CONFIG_TARGET_ROOTFS_EXT4FS is not set
# CONFIG_PACKAGE_dnsmasq is not set
CONFIG_PACKAGE_dnsmasq-full=y
CONFIG_PACKAGE_iw=y
CONFIG_PACKAGE_kmod-mac80211=y
CONFIG_PACKAGE_kmod-cfg80211=y
CONFIG_PACKAGE_kmod-rtl8821cu=y
CONFIG_PACKAGE_rtl8723bu-firmware=y
CONFIG_PACKAGE_bcmdhd-firmware=y
CONFIG_PACKAGE_kmod-rtl8xxxu=y
CONFIG_PACKAGE_kmod-bcmdhd=y
CONFIG_PACKAGE_usbutils=y
CONFIG_PACKAGE_usb-modeswitch=y
CONFIG_PACKAGE_wpa-supplicant=y
CONFIG_PACKAGE_uhttpd=y
CONFIG_PACKAGE_uhttpd-mod-ubus=y
CONFIG_PACKAGE_hostapd=y
CONFIG_PACKAGE_hostapd-common=y
```

## configs/orangepi-5-rk3588_defconfig
```kconfig
CONFIG_TARGET_rockchip=y
CONFIG_TARGET_rockchip_armv8=y
CONFIG_TARGET_rockchip_armv8_DEVICE_xunlong_orangepi-5=y
# CONFIG_PACKAGE_dnsmasq is not set
CONFIG_PACKAGE_dnsmasq-full=y
CONFIG_LUCI_LANG_zh_Hans=y
CONFIG_PACKAGE_luci-app-mwan3=y
CONFIG_PACKAGE_kmod-ipt-nat6=y
CONFIG_PACKAGE_kmod-nf-nat6=y
CONFIG_PACKAGE_kmod-usb-serial-option=y
# CONFIG_PACKAGE_kmod-gpio-button-hotplug is not set
CONFIG_TARGET_KERNEL_PARTSIZE=64
#CONFIG_TARGET_ROOTFS_PARTSIZE=104
CONFIG_PACKAGE_usb-modeswitch=y
CONFIG_PACKAGE_wpa-supplicant=y
CONFIG_PACKAGE_uhttpd=y
CONFIG_PACKAGE_uhttpd-mod-ubus=y
CONFIG_PACKAGE_hostapd=y
CONFIG_PACKAGE_hostapd-common=y
CONFIG_PACKAGE_luci-app-ttyd=y
CONFIG_PACKAGE_iw=y
CONFIG_PACKAGE_iwinfo=y
CONFIG_PACKAGE_luci-app-samba4=y
CONFIG_PACKAGE_luci-app-statistics=y
CONFIG_PACKAGE_luci-app-transmission=y
CONFIG_PACKAGE_luci-app-ttyd=y
CONFIG_PACKAGE_kmod-mac80211=y
CONFIG_PACKAGE_kmod-cfg80211=y
CONFIG_PACKAGE_luci-app-ttyd=y
CONFIG_PACKAGE_luci-app-samba4=y
CONFIG_PACKAGE_luci-app-statistics=y
CONFIG_PACKAGE_luci-app-transmission=y
CONFIG_PACKAGE_luci-app-commands=y
CONFIG_PACKAGE_luci-app-vnstat2=y
# CONFIG_PACKAGE_luci-theme-argon is not set
CONFIG_PACKAGE_luci-app-aria2=y
CONFIG_PACKAGE_luci-app-ddns=y
CONFIG_PACKAGE_luci-app-watchcat=y
CONFIG_PACKAGE_luci-app-adblock=y
CONFIG_PACKAGE_luci-app-nlbwmon=y
CONFIG_PACKAGE_luci-app-ntpc=y
CONFIG_PACKAGE_luci-app-mwan3=y
CONFIG_PACKAGE_luci-app-qos=y
CONFIG_PACKAGE_luci-app-unbound=y
CONFIG_PACKAGE_kmod-rtl8821cu=y
CONFIG_PACKAGE_kmod-rtw88=y
CONFIG_PACKAGE_rtl8723bu-firmware=y
CONFIG_PACKAGE_rtl8723du-firmware=y
CONFIG_PACKAGE_bcmdhd-firmware=y
CONFIG_PACKAGE_kmod-rtl8xxxu=y
CONFIG_PACKAGE_kmod-bcmdhd=y
CONFIG_PACKAGE_luci=y
```
